## Kconfig
```kconfig
menu "Koster Common"

menuconfig KOSTER_COMMON
    bool "Use Koster Common"
    depends on FLASH
    depends on FLASH_MAP
    depends on NVS
    depends on SETTINGS
    depends on SETTINGS_RUNTIME
endmenu
    
if KOSTER_COMMON
module = KOSTER_COMMON
module-str = koster-common

endif
```
